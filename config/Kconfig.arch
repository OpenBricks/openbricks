## config/Kconfig.arch
```kconfig
# This file defines the target architecture, platform and CPU configuration
# options

#######################
# Target architecture #
#######################
choice
  prompt "Target architecture"
  default TARGET_ARCH_i386
  help
    Target system we want to cross compile for

config TARGET_ARCH_i386
  bool "i386"
  help
    A 32-bit x86 system

config TARGET_ARCH_x86_64
  bool "x86_64"
  help
    A 64-bit x86 system

config TARGET_ARCH_powerpc
  bool "powerpc"
  help
    A 32-bit PowerPC system

config TARGET_ARCH_powerpc64
  bool "powerpc64"
  help
    A 64-bit PowerPC system

config TARGET_ARCH_arm
  bool "arm"
  help
   An ARM system

config TARGET_ARCH_mips
  bool "mips"
  help
   A MIPS system

endchoice

config OPT_TARGET_ARCH
  string
  default "i386" if TARGET_ARCH_i386
  default "x86_64" if TARGET_ARCH_x86_64
  default "powerpc" if TARGET_ARCH_powerpc
  default "powerpc64" if TARGET_ARCH_powerpc64
  default "arm" if TARGET_ARCH_arm
  default "mips" if TARGET_ARCH_mips

#######################
# Target sub-arch     #
#######################
choice
  prompt "Target sub-architecture"
  depends on (TARGET_ARCH_i386 || TARGET_ARCH_arm)
  default TARGET_SUBARCH_i586 if TARGET_ARCH_i386
  default TARGET_SUBARCH_armv7 if TARGET_ARCH_arm
  help
    Target subsystem we want to cross compile for

config TARGET_SUBARCH_i386
  bool "i386"
  depends on TARGET_ARCH_i386
  help
   An i386 system

config TARGET_SUBARCH_i486
  bool "i486"
  depends on TARGET_ARCH_i386
  help
   An i486 system

config TARGET_SUBARCH_i586
  bool "i586"
  depends on TARGET_ARCH_i386
  help
   An i586 system

config TARGET_SUBARCH_i686
  bool "i686"
  depends on TARGET_ARCH_i386
  help
   An i686 system

config TARGET_SUBARCH_armv5
  bool "ARMv5 / ARM9"
  depends on TARGET_ARCH_arm
  help
   An ARM9 system

config TARGET_SUBARCH_armv6
  bool "ARMv6 / ARM11"
  depends on TARGET_ARCH_arm
  help
   An ARM11 system

config TARGET_SUBARCH_armv7
  bool "ARMv7 / Cortex"
  depends on TARGET_ARCH_arm
  help
   An ARM Cortex system

endchoice

config OPT_TARGET_SUBARCH
  string
  default "i386" if TARGET_SUBARCH_i386
  default "i486" if TARGET_SUBARCH_i486
  default "i586" if TARGET_SUBARCH_i586
  default "i686" if TARGET_SUBARCH_i686
  default "x86_64" if TARGET_ARCH_x86_64
  default "powerpc" if TARGET_ARCH_powerpc
  default "powerpc64" if TARGET_ARCH_powerpc64
  default "armv5" if TARGET_SUBARCH_armv5
  default "armv6" if TARGET_SUBARCH_armv6
  default "armv7" if TARGET_SUBARCH_armv7
  default "mips" if TARGET_ARCH_mips

#######################
# Target platform     #
#######################
source "../../config/Kconfig.platform"

#######################
# Target CPU          #
#######################
choice TARGET_CPU
  prompt "Target CPU"
  default TARGET_CPU_generic if (TARGET_ARCH_i386 || TARGET_ARCH_x86_64)
  default TARGET_CPU_powerpc if TARGET_ARCH_powerpc
  default TARGET_CPU_powerpc64 if TARGET_ARCH_powerpc64
  default TARGET_CPU_arm926ej-s if TARGET_SUBARCH_armv5
  default TARGET_CPU_arm1136j-s if TARGET_SUBARCH_armv6
  default TARGET_CPU_cortex-a8 if TARGET_SUBARCH_armv7
  default TARGET_CPU_mips32 if TARGET_ARCH_mips
  help
    This option controls which processor should be targeted for the generated
    code.

config TARGET_CPU_generic
  bool "generic"
  depends on (TARGET_ARCH_i386 || TARGET_ARCH_x86_64)

config TARGET_CPU_k8
  bool "k8"
  depends on (TARGET_ARCH_i386 || TARGET_ARCH_x86_64)

config TARGET_CPU_k8-sse3
  bool "k8-sse3"
  depends on (TARGET_ARCH_i386 || TARGET_ARCH_x86_64)

config TARGET_CPU_opteron
  bool "opteron"
  depends on (TARGET_ARCH_i386 || TARGET_ARCH_x86_64)

config TARGET_CPU_opteron-sse3
  bool "opteron-sse3"
  depends on (TARGET_ARCH_i386 || TARGET_ARCH_x86_64)

config TARGET_CPU_athlon64
  bool "athlon64"
  depends on (TARGET_ARCH_i386 || TARGET_ARCH_x86_64)

config TARGET_CPU_athlon64-sse3
  bool "athlon64-sse3"
  depends on (TARGET_ARCH_i386 || TARGET_ARCH_x86_64)

config TARGET_CPU_athlon-fx
  bool "athlon-fx"
  depends on (TARGET_ARCH_i386 || TARGET_ARCH_x86_64)

config TARGET_CPU_amdfam10
  bool "amdfam10"
  depends on TARGET_ARCH_x86_64

config TARGET_CPU_barcelona
  bool "barcelona"
  depends on TARGET_ARCH_x86_64

config TARGET_CPU_athlon-mp
  bool "athlon-mp"
  depends on TARGET_ARCH_i386

config TARGET_CPU_athlon-xp
  bool "athlon-xp"
  depends on TARGET_ARCH_i386

config TARGET_CPU_athlon-4
  bool "athlon-4"
  depends on TARGET_ARCH_i386

config TARGET_CPU_athlon-tbird
  bool "athlon-tbird"
  depends on TARGET_ARCH_i386

config TARGET_CPU_athlon
  bool "athlon"
  depends on TARGET_ARCH_i386

config TARGET_CPU_k6-3
  bool "k6-3"
  depends on TARGET_ARCH_i386

config TARGET_CPU_k6-2
  bool "k6-2"
  depends on TARGET_ARCH_i386

config TARGET_CPU_k6
  bool "k6"
  depends on TARGET_ARCH_i386

config TARGET_CPU_geode
  bool "geode"
  depends on TARGET_ARCH_i386

config TARGET_CPU_core2
  bool "core2"
  depends on (TARGET_ARCH_i386 || TARGET_ARCH_x86_64)

config TARGET_CPU_nocona
  bool "nocona"
  depends on (TARGET_ARCH_i386 || TARGET_ARCH_x86_64)

config TARGET_CPU_atom
  bool "atom"
  depends on TARGET_ARCH_x86_64 

config TARGET_CPU_prescott
  bool "prescott"
  depends on TARGET_ARCH_i386

config TARGET_CPU_pentium4
  bool "pentium4"
  depends on TARGET_ARCH_i386

config TARGET_CPU_pentium4m
  bool "pentium4m"
  depends on TARGET_ARCH_i386

config TARGET_CPU_pentium3
  bool "pentium3"
  depends on TARGET_ARCH_i386

config TARGET_CPU_pentium3m
  bool "pentium3m"
  depends on TARGET_ARCH_i386

config TARGET_CPU_pentium-m
  bool "pentium-m"
  depends on TARGET_ARCH_i386

config TARGET_CPU_pentium2
  bool "pentium2"
  depends on TARGET_ARCH_i386

config TARGET_CPU_pentiumpro
  bool "pentiumpro"
  depends on TARGET_ARCH_i386

config TARGET_CPU_pentium-mmx
  bool "pentium-mmx"
  depends on TARGET_ARCH_i386

config TARGET_CPU_pentium
  bool "pentium"
  depends on TARGET_ARCH_i386

config TARGET_CPU_i686
  bool "i686"
  depends on TARGET_ARCH_i386

config TARGET_CPU_i586
  bool "i586"
  depends on TARGET_ARCH_i386

config TARGET_CPU_i486
  bool "i486"
  depends on TARGET_ARCH_i386

config TARGET_CPU_i386
  bool "i386"
  depends on TARGET_ARCH_i386

config TARGET_CPU_c3
  bool "c3"
  depends on TARGET_ARCH_i386

config TARGET_CPU_c3-2
  bool "c3-2"
  depends on TARGET_ARCH_i386

config TARGET_CPU_401
  bool "401"
  depends on TARGET_ARCH_powerpc

config TARGET_CPU_403
  bool "403"
  depends on TARGET_ARCH_powerpc

config TARGET_CPU_405
  bool "405"
  depends on TARGET_ARCH_powerpc

config TARGET_CPU_405fp
  bool "405fp"
  depends on TARGET_ARCH_powerpc

config TARGET_CPU_440
  bool "440"
  depends on TARGET_ARCH_powerpc

config TARGET_CPU_440fp
  bool "440fp"
  depends on TARGET_ARCH_powerpc

config TARGET_CPU_505
  bool "505"
  depends on TARGET_ARCH_powerpc

config TARGET_CPU_601
  bool "601"
  depends on TARGET_ARCH_powerpc

config TARGET_CPU_602
  bool "602"
  depends on TARGET_ARCH_powerpc

config TARGET_CPU_603
  bool "603"
  depends on TARGET_ARCH_powerpc

config TARGET_CPU_603e
  bool "603e"
  depends on TARGET_ARCH_powerpc

config TARGET_CPU_ec603e
  bool "ec603e"
  depends on TARGET_ARCH_powerpc

config TARGET_CPU_604
  bool "604"
  depends on TARGET_ARCH_powerpc

config TARGET_CPU_604e
  bool "604e"
  depends on TARGET_ARCH_powerpc

config TARGET_CPU_620
  bool "620"
  depends on TARGET_ARCH_powerpc

config TARGET_CPU_630
  bool "630"
  depends on TARGET_ARCH_powerpc

config TARGET_CPU_740
  bool "740"
  depends on TARGET_ARCH_powerpc

config TARGET_CPU_7400
  bool "7400"
  depends on TARGET_ARCH_powerpc

config TARGET_CPU_7450
  bool "7450"
  depends on TARGET_ARCH_powerpc

config TARGET_CPU_750
  bool "750"
  depends on TARGET_ARCH_powerpc

config TARGET_CPU_801
  bool "801"
  depends on TARGET_ARCH_powerpc

config TARGET_CPU_821
  bool "821"
  depends on TARGET_ARCH_powerpc

config TARGET_CPU_823
  bool "823"
  depends on TARGET_ARCH_powerpc

config TARGET_CPU_860
  bool "860"
  depends on TARGET_ARCH_powerpc

config TARGET_CPU_970
  bool "970"
  depends on (TARGET_ARCH_powerpc || TARGET_ARCH_powerpc64)

config TARGET_CPU_rios
  bool "rios"
  depends on TARGET_ARCH_powerpc

config TARGET_CPU_rios1
  bool "rios1"
  depends on TARGET_ARCH_powerpc

config TARGET_CPU_rios2
  bool "rios2"
  depends on TARGET_ARCH_powerpc

config TARGET_CPU_rsc
  bool "rsc"
  depends on TARGET_ARCH_powerpc

config TARGET_CPU_rs64a
  bool "rs64a"
  depends on (TARGET_ARCH_powerpc || TARGET_ARCH_powerpc64)

config TARGET_CPU_common
  bool "common"
  depends on (TARGET_ARCH_powerpc || TARGET_ARCH_powerpc64)

config TARGET_CPU_G3
  bool "G3"
  depends on TARGET_ARCH_powerpc

config TARGET_CPU_G4
  bool "G4"
  depends on TARGET_ARCH_powerpc

config TARGET_CPU_G5
  bool "G5"
  depends on (TARGET_ARCH_powerpc || TARGET_ARCH_powerpc64)

config TARGET_CPU_power
  bool "power"
  depends on TARGET_ARCH_powerpc

config TARGET_CPU_power2
  bool "power2"
  depends on TARGET_ARCH_powerpc

config TARGET_CPU_power3
  bool "power3"
  depends on TARGET_ARCH_powerpc

config TARGET_CPU_power4
  bool "power4"
  depends on (TARGET_ARCH_powerpc || TARGET_ARCH_powerpc64)

config TARGET_CPU_power5
  bool "power5"
  depends on (TARGET_ARCH_powerpc || TARGET_ARCH_powerpc64)

config TARGET_CPU_powerpc
  bool "powerpc"
  depends on TARGET_ARCH_powerpc

config TARGET_CPU_powerpc64
  bool "powerpc64"
  depends on (TARGET_ARCH_powerpc || TARGET_ARCH_powerpc64)

config TARGET_CPU_arm2
  bool "arm2"
  depends on TARGET_ARCH_arm

config TARGET_CPU_arm250
  bool "arm250"
  depends on TARGET_ARCH_arm

config TARGET_CPU_arm3
  bool "arm3"
  depends on TARGET_ARCH_arm

config TARGET_CPU_arm6
  bool "arm6"
  depends on TARGET_ARCH_arm

config TARGET_CPU_arm60
  bool "arm60"
  depends on TARGET_ARCH_arm

config TARGET_CPU_arm600
  bool "arm600"
  depends on TARGET_ARCH_arm

config TARGET_CPU_arm610
  bool "arm610"
  depends on TARGET_ARCH_arm

config TARGET_CPU_arm620
  bool "arm620"
  depends on TARGET_ARCH_arm

config TARGET_CPU_arm7
  bool "arm7"
  depends on TARGET_ARCH_arm

config TARGET_CPU_arm7m
  bool "arm7m"
  depends on TARGET_ARCH_arm

config TARGET_CPU_arm7d
  bool "arm7d"
  depends on TARGET_ARCH_arm

config TARGET_CPU_arm7dm
  bool "arm7dm"
  depends on TARGET_ARCH_arm

config TARGET_CPU_arm7di
  bool "arm7di"
  depends on TARGET_ARCH_arm

config TARGET_CPU_arm7dmi
  bool "arm7dmi"
  depends on TARGET_ARCH_arm

config TARGET_CPU_arm70
  bool "arm70"
  depends on TARGET_ARCH_arm

config TARGET_CPU_arm700
  bool "arm700"
  depends on TARGET_ARCH_arm

config TARGET_CPU_arm700i
  bool "arm700i"
  depends on TARGET_ARCH_arm

config TARGET_CPU_arm710
  bool "arm710"
  depends on TARGET_ARCH_arm

config TARGET_CPU_arm710c
  bool "arm710c"
  depends on TARGET_ARCH_arm

config TARGET_CPU_arm7100
  bool "arm7100"
  depends on TARGET_ARCH_arm

config TARGET_CPU_arm720
  bool "arm720"
  depends on TARGET_ARCH_arm

config TARGET_CPU_arm7500
  bool "arm7500"
  depends on TARGET_ARCH_arm

config TARGET_CPU_arm7500fe
  bool "arm7500fe"
  depends on TARGET_ARCH_arm

config TARGET_CPU_arm7tdmi
  bool "arm7tdmi"
  depends on TARGET_ARCH_arm

config TARGET_CPU_arm7tdmi-s
  bool "arm7tdmi-s"
  depends on TARGET_ARCH_arm

config TARGET_CPU_arm710t
  bool "arm710t"
  depends on TARGET_ARCH_arm

config TARGET_CPU_arm720t
  bool "arm720t"
  depends on TARGET_ARCH_arm

config TARGET_CPU_arm740t
  bool "arm740t"
  depends on TARGET_ARCH_arm

config TARGET_CPU_strongarm
  bool "strongarm"
  depends on TARGET_ARCH_arm

config TARGET_CPU_strongarm110
  bool "strongarm110"
  depends on TARGET_ARCH_arm

config TARGET_CPU_strongarm1100
  bool "strongarm1100"
  depends on TARGET_ARCH_arm

config TARGET_CPU_strongarm1110
  bool "strongarm1110"
  depends on TARGET_ARCH_arm

config TARGET_CPU_arm8
  bool "arm8"
  depends on TARGET_ARCH_arm

config TARGET_CPU_arm810
  bool "arm810"
  depends on TARGET_ARCH_arm

config TARGET_CPU_arm9
  bool "arm9"
  depends on TARGET_ARCH_arm

config TARGET_CPU_arm9e
  bool "arm9e"
  depends on TARGET_ARCH_arm

config TARGET_CPU_arm920
  bool "arm920"
  depends on TARGET_ARCH_arm

config TARGET_CPU_arm920t
  bool "arm920t"
  depends on TARGET_ARCH_arm

config TARGET_CPU_arm922t
  bool "arm922t"
  depends on TARGET_ARCH_arm

config TARGET_CPU_arm946e-s
  bool "arm946e-s"
  depends on TARGET_ARCH_arm

config TARGET_CPU_arm966e-s
  bool "arm966e-s"
  depends on TARGET_ARCH_arm

config TARGET_CPU_arm968e-s
  bool "arm968e-s"
  depends on TARGET_ARCH_arm

config TARGET_CPU_arm926ej-s
  bool "arm926ej-s"
  depends on TARGET_ARCH_arm

config TARGET_CPU_arm940t
  bool "arm940t"
  depends on TARGET_ARCH_arm

config TARGET_CPU_arm9tdmi
  bool "arm9tdmi"
  depends on TARGET_ARCH_arm

config TARGET_CPU_arm10tdmi
  bool "arm10tdmi"
  depends on TARGET_ARCH_arm

config TARGET_CPU_arm1020t
  bool "arm1020t"
  depends on TARGET_ARCH_arm

config TARGET_CPU_arm1026ej-s
  bool "arm1026ej-s"
  depends on TARGET_ARCH_arm

config TARGET_CPU_arm10e
  bool "arm10e"
  depends on TARGET_ARCH_arm

config TARGET_CPU_arm1020e
  bool "arm1020e"
  depends on TARGET_ARCH_arm

config TARGET_CPU_arm1022e
  bool "arm1022e"
  depends on TARGET_ARCH_arm

config TARGET_CPU_arm1136j-s
  bool "arm1136j-s"
  depends on TARGET_ARCH_arm

config TARGET_CPU_arm1136jf-s
  bool "arm1136jf-s"
  depends on TARGET_ARCH_arm

config TARGET_CPU_mpcore
  bool "mpcore"
  depends on TARGET_ARCH_arm

config TARGET_CPU_mpcorenovfp
  bool "mpcorenovfp"
  depends on TARGET_ARCH_arm

config TARGET_CPU_arm1156t2-s
  bool "arm1156t2-s"
  depends on TARGET_ARCH_arm

config TARGET_CPU_arm1176jz-s
  bool "arm1176jz-s"
  depends on TARGET_ARCH_arm

config TARGET_CPU_arm1176jzf-s
  bool "arm1176jzf-s"
  depends on TARGET_ARCH_arm

config TARGET_CPU_cortex-a8
  bool "cortex-a8"
  depends on TARGET_ARCH_arm

config TARGET_CPU_cortex-a9
  bool "cortex-a9"
  depends on TARGET_ARCH_arm

config TARGET_CPU_cortex-r4
  bool "cortex-r4"
  depends on TARGET_ARCH_arm

config TARGET_CPU_cortex-r4f
  bool "cortex-r4f"
  depends on TARGET_ARCH_arm

config TARGET_CPU_cortex-m3
  bool "cortex-m3"
  depends on TARGET_ARCH_arm

config TARGET_CPU_cortex-m1
  bool "cortex-m1"
  depends on TARGET_ARCH_arm

config TARGET_CPU_xscale
  bool "xscale"
  depends on TARGET_ARCH_arm

config TARGET_CPU_iwmmxt
  bool "iwmmxt"
  depends on TARGET_ARCH_arm

config TARGET_CPU_iwmmxt2
  bool "iwmmxt2"
  depends on TARGET_ARCH_arm

config TARGET_CPU_ep9312
  bool "ep9312"
  depends on TARGET_ARCH_arm

config TARGET_CPU_mips32
  bool "mips32"
  depends on TARGET_ARCH_mips

endchoice

config OPT_TARGET_CPU
  string
  default "generic" if TARGET_CPU_generic
  default "k8" if TARGET_CPU_k8
  default "k8-sse3" if TARGET_CPU_k8-sse3
  default "opteron" if TARGET_CPU_opteron
  default "opteron-sse3" if TARGET_CPU_opteron-sse3
  default "athlon64" if TARGET_CPU_athlon64
  default "athlon64-sse3" if TARGET_CPU_athlon64-sse3
  default "athlon-fx" if TARGET_CPU_athlon-fx
  default "amdfam10" if TARGET_CPU_amdfam10
  default "barcelona" if TARGET_CPU_barcelona
  default "athlon-mp" if TARGET_CPU_athlon-mp
  default "athlon-xp" if TARGET_CPU_athlon-xp
  default "athlon-4" if TARGET_CPU_athlon-4
  default "athlon-tbird" if TARGET_CPU_athlon-tbird
  default "athlon" if TARGET_CPU_athlon
  default "k6-3" if TARGET_CPU_k6-3
  default "k6-2" if TARGET_CPU_k6-2
  default "k6" if TARGET_CPU_k6
  default "geode" if TARGET_CPU_geode
  default "core2" if TARGET_CPU_core2
  default "nocona" if TARGET_CPU_nocona
  default "atom" if TARGET_CPU_atom
  default "prescott" if TARGET_CPU_prescott
  default "pentium4" if TARGET_CPU_pentium4
  default "pentium4m" if TARGET_CPU_pentium4m
  default "pentium3" if TARGET_CPU_pentium3
  default "pentium3m" if TARGET_CPU_pentium3m
  default "pentium-m" if TARGET_CPU_pentium-m
  default "pentium2" if TARGET_CPU_pentium2
  default "pentiumpro" if TARGET_CPU_pentiumpro
  default "pentium-mmx" if TARGET_CPU_pentium-mmx
  default "pentium" if TARGET_CPU_pentium
  default "i686" if TARGET_CPU_i686
  default "i586" if TARGET_CPU_i586
  default "i486" if TARGET_CPU_i486
  default "i386" if TARGET_CPU_i386
  default "c3" if TARGET_CPU_c3
  default "c3-2" if TARGET_CPU_c3-2
  default "401" if TARGET_CPU_401
  default "403" if TARGET_CPU_403
  default "405" if TARGET_CPU_405
  default "405fp" if TARGET_CPU_405fp
  default "440" if TARGET_CPU_440
  default "440fp" if TARGET_CPU_440fp
  default "505" if TARGET_CPU_505
  default "601" if TARGET_CPU_601
  default "602" if TARGET_CPU_602
  default "603" if TARGET_CPU_603
  default "603e" if TARGET_CPU_603e
  default "ec603e" if TARGET_CPU_ec603e
  default "604" if TARGET_CPU_604
  default "604e" if TARGET_CPU_604e
  default "620" if TARGET_CPU_620
  default "630" if TARGET_CPU_630
  default "740" if TARGET_CPU_740
  default "7400" if TARGET_CPU_7400
  default "7450" if TARGET_CPU_7450
  default "750" if TARGET_CPU_750
  default "801" if TARGET_CPU_801
  default "821" if TARGET_CPU_821
  default "823" if TARGET_CPU_823
  default "860" if TARGET_CPU_860
  default "970" if TARGET_CPU_970
  default "rios" if TARGET_CPU_rios
  default "rios1" if TARGET_CPU_rios1
  default "rios2" if TARGET_CPU_rios2
  default "rsc" if TARGET_CPU_rsc
  default "rs64a" if TARGET_CPU_rs64a
  default "common" if TARGET_CPU_common
  default "G3" if TARGET_CPU_G3
  default "G4" if TARGET_CPU_G4
  default "G5" if TARGET_CPU_G5
  default "power" if TARGET_CPU_power
  default "power2" if TARGET_CPU_power2
  default "power3" if TARGET_CPU_power3
  default "power4" if TARGET_CPU_power4
  default "power5" if TARGET_CPU_power5
  default "powerpc" if TARGET_CPU_powerpc
  default "powerpc64" if TARGET_CPU_powerpc64
  default "arm2" if TARGET_CPU_arm2
  default "arm250" if TARGET_CPU_arm250
  default "arm3" if TARGET_CPU_arm3
  default "arm6" if TARGET_CPU_arm6
  default "arm60" if TARGET_CPU_arm60
  default "arm600" if TARGET_CPU_arm600
  default "arm610" if TARGET_CPU_arm610
  default "arm620" if TARGET_CPU_arm620
  default "arm7" if TARGET_CPU_arm7
  default "arm7m" if TARGET_CPU_arm7m
  default "arm7d" if TARGET_CPU_arm7d
  default "arm7dm" if TARGET_CPU_arm7dm
  default "arm7di" if TARGET_CPU_arm7di
  default "arm7dmi" if TARGET_CPU_arm7dmi
  default "arm70" if TARGET_CPU_arm70
  default "arm700" if TARGET_CPU_arm700
  default "arm700i" if TARGET_CPU_arm700i
  default "arm710" if TARGET_CPU_arm710
  default "arm710c" if TARGET_CPU_arm710c
  default "arm7100" if TARGET_CPU_arm7100
  default "arm720" if TARGET_CPU_arm720
  default "arm7500" if TARGET_CPU_arm7500
  default "arm7500fe" if TARGET_CPU_arm7500fe
  default "arm7tdmi" if TARGET_CPU_arm7tdmi
  default "arm7tdmi-s" if TARGET_CPU_arm7tdmi-s
  default "arm710t" if TARGET_CPU_arm710t
  default "arm720t" if TARGET_CPU_arm720t
  default "arm740t" if TARGET_CPU_arm740t
  default "strongarm" if TARGET_CPU_strongarm
  default "strongarm110" if TARGET_CPU_strongarm110
  default "strongarm1100" if TARGET_CPU_strongarm1100
  default "strongarm1110" if TARGET_CPU_strongarm1110
  default "arm8" if TARGET_CPU_arm8
  default "arm810" if TARGET_CPU_arm810
  default "arm9" if TARGET_CPU_arm9
  default "arm9e" if TARGET_CPU_arm9e
  default "arm920" if TARGET_CPU_arm920
  default "arm920t" if TARGET_CPU_arm920t
  default "arm922t" if TARGET_CPU_arm922t
  default "arm946e-s" if TARGET_CPU_arm946e-s
  default "arm966e-s" if TARGET_CPU_arm966e-s
  default "arm968e-s" if TARGET_CPU_arm968e-s
  default "arm926ej-s" if TARGET_CPU_arm926ej-s
  default "arm940t" if TARGET_CPU_arm940t
  default "arm9tdmi" if TARGET_CPU_arm9tdmi
  default "arm10tdmi" if TARGET_CPU_arm10tdmi
  default "arm1020t" if TARGET_CPU_arm1020t
  default "arm1026ej-s" if TARGET_CPU_arm1026ej-s
  default "arm10e" if TARGET_CPU_arm10e
  default "arm1020e" if TARGET_CPU_arm1020e
  default "arm1022e" if TARGET_CPU_arm1022e
  default "arm1136j-s" if TARGET_CPU_arm1136j-s
  default "arm1136jf-s" if TARGET_CPU_arm1136jf-s
  default "mpcore" if TARGET_CPU_mpcore
  default "mpcorenovfp" if TARGET_CPU_mpcorenovfp
  default "arm1156t2-s" if TARGET_CPU_arm1156t2-s
  default "arm1176jz-s" if TARGET_CPU_arm1176jz-s
  default "arm1176jzf-s" if TARGET_CPU_arm1176jzf-s
  default "cortex-a8" if TARGET_CPU_cortex-a8
  default "cortex-a9" if TARGET_CPU_cortex-a9
  default "cortex-r4" if TARGET_CPU_cortex-r4
  default "cortex-r4f" if TARGET_CPU_cortex-r4f
  default "cortex-m3" if TARGET_CPU_cortex-m3
  default "cortex-m1" if TARGET_CPU_cortex-m1
  default "xscale" if TARGET_CPU_xscale
  default "iwmmxt" if TARGET_CPU_iwmmxt
  default "iwmmxt2" if TARGET_CPU_iwmmxt2
  default "ep9312" if TARGET_CPU_ep9312
  default "mips32" if TARGET_CPU_mips32
```
