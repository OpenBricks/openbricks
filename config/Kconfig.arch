## config/Kconfig.platform
```kconfig
#######################
# Target platform     #
#######################
config TARGET_PLATFORM_generic
  bool
  default n

choice
  prompt "Target platforn"
  default TARGET_PLATFORM_x86_generic if (TARGET_ARCH_i386 || TARGET_ARCH_x86_64)
  default TARGET_PLATFORM_powerpc_generic if TARGET_ARCH_powerpc
  default TARGET_PLATFORM_powerpc64_generic if TARGET_ARCH_powerpc64
  default TARGET_PLATFORM_arm_omap3 if TARGET_ARCH_arm
  default TARGET_PLATFORM_mips_generic if TARGET_ARCH_mips
  help
    Target platform

config TARGET_PLATFORM_x86_generic
  bool "generic"
  depends on (TARGET_ARCH_i386 || TARGET_ARCH_x86_64)
  select TARGET_PLATFORM_generic
  select TARGET_CPU_generic
  help
    A generic x86 system

config TARGET_PLATFORM_x86_64_ion
  bool "nVidia ION"
  depends on  TARGET_ARCH_x86_64
  select TARGET_CPU_atom
  select TAINT
  select USE_xorg
  select USE_vdpau
  select PKG_xf86-video-nvidia
  help
    nVidia ION system

config TARGET_PLATFORM_x86_vmware
  bool "VMware"
  depends on (TARGET_ARCH_i386 || TARGET_ARCH_x86_64)
  select TARGET_CPU_generic
  select PKG_xf86-video-vmware if USE_xorg
  help
    VMware virtual machine

config TARGET_PLATFORM_powerpc_generic
  bool "generic"
  depends on TARGET_ARCH_powerpc
  select TARGET_PLATFORM_generic
  select TARGET_CPU_powerpc
  help
    A generic 32-bit PowerPC system

config TARGET_PLATFORM_powerpc64_generic
  bool "generic"
  depends on TARGET_ARCH_powerpc64
  select TARGET_PLATFORM_generic
  select TARGET_CPU_powerpc64
  help
    A generic 64-bit PowerPC system

config TARGET_PLATFORM_arm_omap3
  bool "OMAP3"
  depends on TARGET_ARCH_arm
  select TARGET_CPU_cortex-a8
  select PKG_xf86-video-fbdev if USE_xorg
  select PKG_xf86-video-omapfb if USE_xorg
  help
    A generic TI OMAP3 system

config TARGET_PLATFORM_mips_generic
  bool "generic"
  depends on TARGET_ARCH_mips
  select TARGET_PLATFORM_generic
  select TARGET_CPU_mips32
  help
    A generic 32-bit MIPS system

endchoice

config GX_TARGET_PLATFORM
  string
  default "generic" if TARGET_PLATFORM_generic
  default "ion" if TARGET_PLATFORM_x86_64_ion
  default "vmware" if TARGET_PLATFORM_x86_vmware
  default "omap3" if TARGET_PLATFORM_arm_omap3
```

## config/Kconfig.remote
```kconfig
# This file defines the remote and receiver configuration options

choice REMOTE
  prompt "Remote"
  default REMOTE_atiusb

config REMOTE_animax
  bool "animax"

config REMOTE_askey
  bool "askey"

config REMOTE_atiusb
  bool "atiusb"

config REMOTE_atiusb2
  bool "atiusb2"

config REMOTE_avermedia
  bool "avermedia"

config REMOTE_cinergy1400
  bool "cinergy1400"

config REMOTE_creative
  bool "creative"

config REMOTE_D-10
  bool "D-10"

config REMOTE_digimatrix
  bool "digimatrix"

config REMOTE_dvico
  bool "dvico"

config REMOTE_flytv-prime
  bool "flytv-prime"

config REMOTE_hauppauge
  bool "hauppauge"

config REMOTE_imonknob
  bool "imonknob"

config REMOTE_leadtek
  bool "leadtek"

config REMOTE_leadtek-pvr2000
  bool "leadtek-pvr2000"

config REMOTE_LG
  bool "LG"

config REMOTE_logitech
  bool "logitech"

config REMOTE_mceusb
  bool "mceusb"

config REMOTE_MCE-X10
  bool "MCE-X10"

config REMOTE_Medion-X10
  bool "Medion-X10"

config REMOTE_nova-s-plus
  bool "nova-s-plus"

config REMOTE_packard_bell
  bool "packard_bell"

config REMOTE_pctv
  bool "pctv"

config REMOTE_realmagic
  bool "realmagic"

config REMOTE_RM-S6
  bool "RM-S6"

config REMOTE_RX-V850
  bool "RX-V850"

config REMOTE_streamzap
  bool "streamzap"

config REMOTE_tosh-vt76f
  bool "tosh-vt76f"

config REMOTE_twinhan
  bool "twinhan"

config REMOTE_ultrax
  bool "ultrax"

endchoice

choice RECEIVER
  prompt "Receiver"
  default RECEIVER_atiusb

config RECEIVER_animax
  bool "animax"

config RECEIVER_askey
  bool "askey"

config RECEIVER_avermedia
  bool "avermedia"

config RECEIVER_atiusb
  bool "atiusb"

config RECEIVER_atiusb2
  bool "atiusb2"

config RECEIVER_creative
  bool "creative"

config RECEIVER_hauppauge
  bool "hauppauge"

config RECEIVER_homemade
  bool "homemade"

config RECEIVER_irman
  bool "irman"

config RECEIVER_leadtek
  bool "leadtek"

config RECEIVER_leadtek-pvr2000
  bool "leadtek-pvr2000"

config RECEIVER_logitech
  bool "logitech"

config RECEIVER_pctv
  bool "pctv"

config RECEIVER_realmagic
  bool "realmagic"

config RECEIVER_digimatrix
  bool "digimatrix"

config RECEIVER_mceusb
  bool "mceusb"

config RECEIVER_mceusb2
  bool "mceusb2"

config RECEIVER_nuvoton
  bool "nuvoton"

config RECEIVER_streamzap
  bool "streamzap"

config RECEIVER_cx88
  bool "cx88"

config RECEIVER_imonknob
  bool "imonknob"

config RECEIVER_ultrax
  bool "ultrax"

config RECEIVER_dvico
  bool "dvico"

config RECEIVER_MCE-X10
  bool "MCE-X10"

endchoice

config GX_REMOTE
  string
  default "animax" if REMOTE_animax
  default "askey" if REMOTE_askey
  default "atiusb" if REMOTE_atiusb
  default "atiusb2" if REMOTE_atiusb2
  default "avermedia" if REMOTE_avermedia
  default "cinergy1400" if REMOTE_cinergy1400
  default "creative" if REMOTE_creative
  default "D-10" if REMOTE_D-10
  default "digimatrix" if REMOTE_digimatrix
  default "dvico" if REMOTE_dvico
  default "flytv-prime" if REMOTE_flytv-prime
  default "hauppauge" if REMOTE_hauppauge
  default "imonknob" if REMOTE_imonknob
  default "leadtek" if REMOTE_leadtek
  default "leadtek-pvr2000" if REMOTE_leadtek-pvr2000
  default "LG" if REMOTE_LG
  default "logitech" if REMOTE_logitech
  default "mceusb" if REMOTE_mceusb
  default "MCE-X10" if REMOTE_MCE-X10
  default "Medion-X10" if REMOTE_Medion-X10
  default "nova-s-plus" if REMOTE_nova-s-plus
  default "packard_bell" if REMOTE_packard_bell
  default "pctv" if REMOTE_pctv
  default "realmagic" if REMOTE_realmagic
  default "RM-S6" if REMOTE_RM-S6
  default "RX-V850" if REMOTE_RX-V850
  default "streamzap" if REMOTE_streamzap
  default "tosh-vt76f" if REMOTE_tosh-vt76f
  default "twinhan" if REMOTE_twinhan
  default "ultrax" if REMOTE_ultrax

config GX_RECEIVER
  string
  default "animax" if RECEIVER_animax
  default "askey" if RECEIVER_askey
  default "avermedia" if RECEIVER_avermedia
  default "atiusb" if RECEIVER_atiusb
  default "atiusb2" if RECEIVER_atiusb2
  default "creative" if RECEIVER_creative
  default "hauppauge" if RECEIVER_hauppauge
  default "homemade" if RECEIVER_homemade
  default "irman" if RECEIVER_irman
  default "leadtek" if RECEIVER_leadtek
  default "leadtek-pvr2000" if RECEIVER_leadtek-pvr2000
  default "logitech" if RECEIVER_logitech
  default "pctv" if RECEIVER_pctv
  default "realmagic" if RECEIVER_realmagic
  default "digimatrix" if RECEIVER_digimatrix
  default "mceusb" if RECEIVER_mceusb
  default "mceusb2" if RECEIVER_mceusb2
  default "nuvoton" if RECEIVER_nuvoton
  default "streamzap" if RECEIVER_streamzap
  default "cx88" if RECEIVER_cx88
  default "imonknob" if RECEIVER_imonknob
  default "ultrax" if RECEIVER_ultrax
  default "dvico" if RECEIVER_dvico
  default "MCE-X10" if RECEIVER_MCE-X10
```

## config/platforms/arm/bcmring/Kconfig
```kconfig
config TARGET_PLATFORM_arm_bcmring
  bool "Broadcom BCMRing"
  depends on TARGET_SUBARCH_armv6
  select TARGET_CPU_arm1136j-s
  help
    A generic Broadcom BCMRing system
```

## config/platforms/arm/kirkwood/Kconfig
```kconfig
config TARGET_PLATFORM_arm_kirkwood
  bool "Marvell Kirkwood"
  depends on TARGET_SUBARCH_armv5
  select TARGET_CPU_arm926ej-s
  help
    A generic Marvell Kirkwood system
```

## config/platforms/arm/omap3/Kconfig
```kconfig
config TARGET_PLATFORM_arm_omap3
  bool "OMAP3"
  depends on TARGET_SUBARCH_armv7
  select TARGET_CPU_cortex-a8
  select PKG_xf86-video-fbdev if USE_xorg
  select PKG_xf86-video-omapfb if USE_xorg
  help
    A generic TI OMAP3 system
```

## config/platforms/arm/omap4/Kconfig
```kconfig
config TARGET_PLATFORM_arm_omap4
  bool "OMAP4"
  depends on TARGET_SUBARCH_armv7
  select TARGET_CPU_cortex-a9
  select PKG_syslink
  select PKG_xf86-video-fbdev if USE_xorg
  select PKG_xf86-video-omapfb if USE_xorg
  help
    A generic TI OMAP4 system
```

## config/platforms/arm/qemu/Kconfig
```kconfig
config TARGET_PLATFORM_arm_qemu
  bool "QEMU"
  depends on TARGET_SUBARCH_armv5
  select TARGET_CPU_arm926ej-s
  help
    An ARM9 system (VersatilePB) emulated by QEMU.
```

## config/platforms/arm/tegra2/Kconfig
```kconfig
config TARGET_PLATFORM_arm_tegra2
  bool "NVIDIA Tegra2"
  depends on TARGET_SUBARCH_armv7
  select TARGET_CPU_cortex-a9
  select FPU_OPTIMIZATIONS_VFP3
  select PKG_xf86-video-fbdev if USE_xorg
  select PKG_xf86-video-tegra if (USE_xorg && TAINT)
  help
    A generic NVIDIA Tegra 250 system
```

## config/platforms/arm/versatilepb/Kconfig
```kconfig
config TARGET_PLATFORM_arm_versatilepb
  bool "ARM Versatile Platform Baseboard"
  depends on TARGET_SUBARCH_armv5
  select TARGET_CPU_arm926ej-s
  help
    ARM9 reference platform
```

## config/platforms/i386/generic/Kconfig
```kconfig
config TARGET_PLATFORM_i386_generic
  bool "generic"
  depends on TARGET_ARCH_i386
  select TARGET_CPU_generic
  help
    A generic 32-bit x86 system
```

## config/platforms/i386/vmware/Kconfig
```kconfig
config TARGET_PLATFORM_i386_vmware
  bool "VMware"
  depends on TARGET_ARCH_i386
  select TARGET_CPU_generic
  select PKG_xf86-video-vmware if USE_xorg
  help
    VMware virtual machine
```

## config/platforms/mips/generic/Kconfig
```kconfig
config TARGET_PLATFORM_mips_generic
  bool "generic"
  depends on TARGET_ARCH_mips
  select TARGET_CPU_mips32
  help
    A generic 32-bit MIPS system
```

## config/platforms/powerpc/generic/Kconfig
```kconfig
config TARGET_PLATFORM_powerpc_generic
  bool "generic"
  depends on TARGET_ARCH_powerpc
  select TARGET_CPU_powerpc
  help
    A generic 32-bit PowerPC system
```

## config/platforms/powerpc64/generic/Kconfig
```kconfig
config TARGET_PLATFORM_powerpc64_generic
  bool "generic"
  depends on TARGET_ARCH_powerpc64
  select TARGET_CPU_powerpc64
  help
    A generic 64-bit PowerPC system
```

## config/platforms/x86_64/generic/Kconfig
```kconfig
config TARGET_PLATFORM_x86_64_generic
  bool "generic"
  depends on TARGET_ARCH_x86_64
  select TARGET_CPU_generic
  help
    A generic x86_64 system
```

## config/platforms/x86_64/ion/Kconfig
```kconfig
config TARGET_PLATFORM_x86_64_ion
  bool "nVidia ION"
  depends on  TARGET_ARCH_x86_64
  select TARGET_CPU_atom
  select TAINT
  select USE_xorg
  select USE_vdpau
  select PKG_xf86-video-nvidia
  help
    nVidia ION system
```

## config/platforms/x86_64/vmware/Kconfig
```kconfig
config TARGET_PLATFORM_x86_64_vmware
  bool "VMware"
  depends on TARGET_ARCH_x86_64
  select TARGET_CPU_generic
  select PKG_xf86-video-vmware if USE_xorg
  help
    VMware virtual machine
```

## config/tasks/base/Kconfig
```kconfig
config TASK_base
  bool "base - starting point for a bootable system"
  default y
  select PKG_base-files
  select PKG_gcc-final
  select PKG_busybox
  select PKG_util-linux-ng
  select PKG_linux
  select PKG_udev
  select PKG_upstart
  help
    Very basic system able to boot up to a busybox shell.
```

## config/tasks/geexbox/Kconfig
```kconfig
config TASK_geexbox
  bool "GeeXboX - Embedded Linux Media Center Distribution"
  select PKG_base-files
  select PKG_gcc-final
  select PKG_busybox
  select PKG_util-linux-ng
  select PKG_linux
  select PKG_udev
  select PKG_upstart
  select PKG_opkg
  select PKG_pcmciautils
  select PKG_alsa
  select PKG_debug
  select PKG_enna
  select PKG_automountd
  select PKG_i18n
  help
    GeeXboX is a free and Open Source Media-Center purposed Linux distribution
    for embedded devices and desktop computers. GeeXboX is not an application,
    it's a full-featured OS, that one can boot as a LiveCD, from a USB key, an
    SD/MMC card or install on its regular HDD. The GeeXboX distribution is 
    lightweight and designed for one single goal: embed all major multimedia 
    applications as to turn your computer into an HTPC.
```
